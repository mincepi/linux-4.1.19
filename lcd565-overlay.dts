/dts-v1/;
/plugin/;

/{
	compatible = "brcm,bcm2708";

	fragment@0 {
		target-path = "/";
		__overlay__ {
			lcd565: lcd565 {
				compatible = "lcd565";
				pinctrl-names = "default";
				pinctrl-0 = <&lcd565_pins>;
				status = "okay";
			};
		};
	};

	fragment@1 {
		target = <&gpio>;
		__overlay__ {
			lcd565_pins: lcd565_pins {
				brcm,pins = <0x0 0x1 0x4 0x5 0x6 0x7 0x8 0xc 0xd 0xe 0xf 0x10 0x11 0x12 0x14 0x15 0x16 0x17 0x18 0x19 0x1a>;
				brcm,function = <0x6 0x6 0x6 0x6 0x6 0x6 0x6 0x6 0x6 0x6 0x6 0x6 0x6 0x1 0x6 0x6 0x6 0x6 0x6 0x1 0x1>;
				brcm,pull = <0x0 0x0 0x0 0x0 0x0 0x0 0x0 0x0 0x0 0x0 0x0 0x0 0x0 0x2 0x0 0x0 0x0 0x0 0x0 0x2 0x2>;
			};
		};
	};
};
